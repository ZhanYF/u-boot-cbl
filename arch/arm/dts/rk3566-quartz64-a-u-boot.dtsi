// SPDX-License-Identifier: GPL-2.0+
/*
 * (C) Copyright 2023 Ondrej Jirman <megi@xff.cz>
 */

#include "rk356x-u-boot.dtsi"

/ {
	chosen {
		stdout-path = &uart2;
		u-boot,spl-boot-order = &sdmmc0;
	};
};

&uart2 {
	bootph-all;
	clock-frequency = <24000000>;
	status = "okay";
	u-boot,dm-spl;
};

&sdmmc0 {
	pinctrl-0 = <&sdmmc0_bus4 &sdmmc0_clk &sdmmc0_cmd &sdmmc0_det &sdmmc0_pwren>;
};
